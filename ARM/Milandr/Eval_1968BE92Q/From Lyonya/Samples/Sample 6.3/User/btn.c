/*******************************************************************************
 * @File: btn.c
 * @Author: Milandr, L.
 * @Project: Sample 6.3
 * @Microcontroller: 1986VE92U
 * @Device: Evaluation Board For MCU 1986VE92U
 * @Date: 18.07.2018
 * @Purpose: Конфигурация линий ввода-вывода для работы с кнопкой
 *******************************************************************************/

// Подключение заголовочного файла
#include "btn.h"

// Инициализация порта для работы с кнопкой
void BTN_Init(void)
{
  // Включение тактирования порта B
  MDR_RST_CLK->PER_CLOCK |= (1 << RST_CLK_PCLK_PORTB_Pos);

  // Конфигурация линии PB0 для работы с кнопкой
  MDR_PORTB->OE     &= ~(1 << 0);   // Направление данных (ввод)
  MDR_PORTB->FUNC   &= ~(3 << 0);   // Функция линии (ввод-вывод)
  MDR_PORTB->ANALOG |=  (1 << 0);   // Режим работы линии (цифровой)
  MDR_PORTB->PULL   &= ~(1 << 0);   // Подтяжка к земле (отключена)
  MDR_PORTB->PULL   &= ~(1 << 16);  // Подтяжка к питанию (отключена)
  MDR_PORTB->PD     &= ~(1 << 0);   // Управление линией (не используется)
  MDR_PORTB->PD     &= ~(1 << 16);  // Триггер Шмитта (отключен)
  MDR_PORTB->PWR    &= ~(3 << 0);   // Cброс битов регистра PWR
  MDR_PORTB->PWR    |=  (1 << 0);   // Крутизна фронтов (низкая)
  MDR_PORTB->GFEN   &= ~(1 << 0);   // Цифровой фильтр (отключен)
}

// Поток опроса кнопки джойстика
void Thread_JoystickButtonCheck(void *argument)
{
  // Отображение исходного сообщения
  LCD_PutString("      RELEASED", 7);

  // Основной цикл
  while (1)
  {
    // Проверка нажатия
    if ((MDR_PORTB->RXTX & (1 << 0)) == 0)
    {
      // Отображение сообщения о нажатии кнопки
      LCD_PutString("      PRESSED", 7);

      // Ожидание отпускания
      while ((MDR_PORTB->RXTX & (1 << 0)) == 0)
        osDelay(25);

      // Отображение сообщения об отпускании кнопки
      LCD_PutString("      RELEASED", 7);
    }

    // Задержка перед началом следующей проверки
    osDelay(25);
  }
}
