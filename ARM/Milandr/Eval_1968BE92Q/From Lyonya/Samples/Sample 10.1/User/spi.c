/*******************************************************************************
 * @File: spi.c
 * @Author: Milandr, L.
 * @Project: Sample 10.1
 * @Microcontroller: 1986VE92U
 * @Device: Evaluation Board For MCU 1986VE92U
 * @Date: 19.05.2017
 * @Purpose: Реализация интерфейса SPI
 *******************************************************************************/

// Подключение заголовочного файла
#include "spi.h"

// Деинициализация контроллера SSP
void SPI_Reset(MDR_SSP_TypeDef* MDR_SSPx)
{
  MDR_SSPx->CR0   = 0;
  MDR_SSPx->CR1   = 0;
  MDR_SSPx->CPSR  = 0;
  MDR_SSPx->IMSC  = 0;
  MDR_SSPx->DMACR = 0;
}

// Конфигурация порта для работы интерфейса SPI (SSP1)
void SPI_PortCfg(void)
{
  // Конфигурация линий PF0 (MOSI), PF1 (SCLK), PF2 (SS) и PF3 (MISO)
  MDR_PORTF->OE     &= ~((1 << 3));                                       // Направление данных (PF3 - ввод)
  MDR_PORTF->OE     |=  ((1 << 0)  | (1 << 1)  | (1 << 2));               // Направление данных (PF0, PF1, PF2 - вывод)
  MDR_PORTF->PULL   &= ~((1 << 0)  | (1 << 1)  | (1 << 2)  | (1 << 3));   // Подтяжка к земле (отключена)
  MDR_PORTF->PULL   &= ~((1 << 16) | (1 << 17) | (1 << 18) | (1 << 19));  // Подтяжка к питанию (отключена)
  MDR_PORTF->ANALOG |=  ((1 << 0)  | (1 << 1)  | (1 << 2)  | (1 << 3));   // Режим работы линий (цифровой)
  MDR_PORTF->FUNC   &= ~((3 << 0)  | (3 << 2)  | (3 << 4)  | (3 << 6));   // Cброс битов регистра FUNC
  MDR_PORTF->FUNC   |=  ((2 << 0)  | (2 << 2)  | (0 << 4)  | (2 << 6));   // Функции линий (PF0, PF1, PF3 - альтернативная, PF2 - ввод-вывод)
  MDR_PORTF->PD     &= ~((1 << 0)  | (1 << 1)  | (1 << 2)  | (1 << 3));   // Управление линиями (не используется) 
  MDR_PORTF->PD     &= ~((1 << 16) | (1 << 17) | (1 << 18) | (1 << 19));  // Триггеры Шмитта (не используются)
  MDR_PORTF->PWR    |=  ((3 << 0)  | (3 << 2)  | (3 << 4)  | (3 << 6));;  // Крутизна фронтов (высокая)
  MDR_PORTF->GFEN   &= ~((1 << 0)  | (1 << 1)  | (1 << 2)  | (1 << 3));;  // Цифровые фильтры (не используются)
}

// Инициализация интерфейса SPI (SSP1)
void SPI_Init(void)
{
  // Включение тактирования порта F
  MDR_RST_CLK->PER_CLOCK |= (1 << RST_CLK_PCLK_PORTF_Pos);

  // Конфигурация порта для работы интерфейса SPI
  SPI_PortCfg();

  // Включение тактирования модуля SSP1
  MDR_RST_CLK->PER_CLOCK |= (1 << RST_CLK_PCLK_SSP1_Pos);
  MDR_RST_CLK->SSP_CLOCK |= (1 << RST_CLK_SSP_CLOCK_SSP1_CLK_EN_Pos);

  // Деинициализация контроллера SSP
  SPI_Reset(MDR_SSP1);

  // Конфигурация контроллера SSP
  MDR_SSP1->CR0 = (7 << SSP_CR0_DSS_Pos)   // Длина кадра данных (8 бит)
                | (0 << SSP_CR0_FRF_Pos)   // Формат кадра данных (SPI)
                | (0 << SSP_CR0_SPO_Pos)   // Полярность тактовых импульсов (CPOL = 0)
                | (0 << SSP_CR0_SPH_Pos)   // Фронт выборки данных (передний, CPHA = 0)
                | (0 << SSP_CR0_SCR_Pos);  // Фактор скорости передачи данных (не используется)

  MDR_SSP1->CR1 = (0 << SSP_CR1_LBM_Pos)   // Режим самотестирования (отключен)
                | (1 << SSP_CR1_SSE_Pos)   // Работа приемопередатчика (включен)
                | (0 << SSP_CR1_MS_Pos)    // Роль в сети (ведущий)
                | (0 << SSP_CR1_SOD_Pos);  // Отключение линии передачи (не используется)

  // Задание делителя тактовой частоты для достижения требуемой скрости
  MDR_SSP1->CPSR = SystemCoreClock / SPI_SPEED;

  // Исходное (неактивное) состояние линии SS
  SPI_RaiseSS;
}

// Упрощенная передача данных по интерфейсу SPI
// (без учета организации памяти приемника)
void SPI_SimpleTransmit(MDR_SSP_TypeDef *MDR_SSPx,  // Используемый контроллер (SSP1/SSP2)
                        uint8_t data)               // Передаваемые данные
{
  // Активация линии SS
  SPI_LowerSS;

  // Передача данных
  MDR_SSPx->DR = data;

  // Ожидание завершения передачи
  while ((MDR_SSPx->SR & SSP_SR_BSY) != 0);

  // Очистка буфера приемника
  MDR_SSPx->DR;

  // Деактивация линии SS
  SPI_RaiseSS;
}

// Передача данных по интерфейсу SPI
void SPI_TransmitData(MDR_SSP_TypeDef *MDR_SSPx,  // Используемый контроллер (SSP1/SSP2)
                      uint8_t address,            // Адрес регистра памяти устройства
                      uint8_t data)               // Передаваемые данные
{
  // Активация линии SS
  SPI_LowerSS;

  // Передача адреса регистра и признака записи данных (бит 7 = R/W = 0)
  MDR_SSPx->DR = address & 0x7F;

  // Ожидание завершения передачи
  while ((MDR_SSPx->SR & SSP_SR_BSY) != 0);

  // Очистка буфера приемника
  MDR_SSPx->DR;

  // Передача данных
  MDR_SSPx->DR = data;

  // Ожидание завершения передачи
  while ((MDR_SSPx->SR & SSP_SR_BSY) != 0);

  // Очистка буфера приемника
  MDR_SSPx->DR;

  // Деактивация линии SS
  SPI_RaiseSS;
}

// Прием данных по интерфейсу SPI
uint8_t SPI_ReceiveData(MDR_SSP_TypeDef *MDR_SSPx,  // Используемый контроллер (SSP1/SSP2)
                        uint8_t address)            // Адрес регистра памяти устройства
{
  // Активация линии SS
  SPI_LowerSS;

  // Передача адреса регистра и признака чтения данных (бит 7 = R/W = 1)
  MDR_SSPx->DR = address | 0x80;

  // Ожидание завершения передачи
  while ((MDR_SSPx->SR & SSP_SR_BSY) != 0);

  // Очистка буфера приемника
  MDR_SSPx->DR;

  // Передача незначимых данных по линии MOSI
  // с целью приема данных по линии MISO
  MDR_SSPx->DR = 0x00;

  // Ожидание завершения передачи
  while ((MDR_SSPx->SR & SSP_SR_BSY) != 0);

  // Деактивация линии SS
  SPI_RaiseSS;

  return MDR_SSPx->DR;
}

// Последовательный прием нескольких пакетов данных
void SPI_ReceiveDataBurst(MDR_SSP_TypeDef *MDR_SSPx,  // Используемый контроллер (SSP1/SSP2)
                          uint8_t address,            // Адрес начального регистра памяти устройства
                          uint8_t amount,             // Количество циклов получения
                          uint8_t *buffer)            // Буфер для хранения результатов чтения
{
  uint8_t i;

  // Активация линии SS
  SPI_LowerSS;

  // Передача адреса регистра и признака чтения данных (бит 7 = R/W = 1)
  MDR_SSPx->DR = address | 0x80;

  // Ожидание завершения передачи
  while ((MDR_SSPx->SR & SSP_SR_BSY) != 0);

  // Очистка буфера приемника
  MDR_SSPx->DR;

  // Цикл чтения
  for (i = 0; i < amount; i++)
  {
    // Передача незначимых данных по линии MOSI
    // с целью приема данных по линии MISO
    MDR_SSPx->DR = 0x00;

    // Ожидание завершения передачи
    while ((MDR_SSPx->SR & SSP_SR_BSY) != 0);

    // Запись принятых данных в массив
    buffer[i] = MDR_SSPx->DR;
  }

  // Деактивация линии SS
  SPI_RaiseSS;
}
