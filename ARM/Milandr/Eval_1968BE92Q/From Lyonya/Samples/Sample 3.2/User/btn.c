/*******************************************************************************
 * @File: btn.c
 * @Author: Milandr, L.
 * @Project: Sample 3.2
 * @Microcontroller: 1986VE92U
 * @Device: Evaluation Board For MCU 1986VE92U
 * @Date: 15.03.2019
 * @Purpose: Конфигурация линий ввода-вывода для работы с кнопками
 *******************************************************************************/

// Подключение заголовочного файла
#include "btn.h"

// Инициализация порта для работы с кнопкой
void BTN_Init(void)
{
  // Включение тактирования порта C
  MDR_RST_CLK->PER_CLOCK |= (1 << RST_CLK_PCLK_PORTC_Pos);

  // Конфигурация линии PC2 для работы с кнопкой
  MDR_PORTC->OE     &= ~(1 << 2);   // Направление данных (ввод)
  MDR_PORTC->PULL   &= ~(1 << 2);   // Подтяжка к земле (отключена)
  MDR_PORTC->PULL   &= ~(1 << 18);  // Подтяжка к питанию (отключена)
  MDR_PORTC->ANALOG |=  (1 << 2);   // Режим работы линии (цифровой)
  MDR_PORTC->FUNC   &= ~(3 << 4);   // Функция линии (в вод-вывод)
  MDR_PORTC->PD     &= ~(1 << 2);   // Управление линией (не используется)
  MDR_PORTC->PD     &= ~(1 << 18);  // Триггер Шмитта (отключен)
  MDR_PORTC->PWR    &= ~(3 << 4);   // Cброс битов регистра PWR
  MDR_PORTC->PWR    |=  (1 << 4);   // Крутизна фронтов (низкая)
  MDR_PORTC->GFEN   &= ~(1 << 2);   // Цифровой фильтр (отключен)
}

// Поток опроса кнопки
void Thread_ButtonCheck(void *argument)
{
  float interval;             // Временной интервал между нажатиями кнопки
  char message[LCD_STR_LEN];  // Сообщение, отображаемое на дисплей

  // Основной цикл
  while(1)
  {
    // Проверка нажатия
    if ((MDR_PORTC->RXTX & (1 << 2)) == 0)
    {
      // Задержка для защиты от дребезга контактов
      osDelay(10);

      // Подтверждение нажатия
      if ((MDR_PORTC->RXTX & (1 << 2)) == 0)
      {
        // Фиксация интервала
        interval = CNT_TO_TIME(MDR_TIMER1->CNT);

        // Сброс счетчика
        MDR_TIMER1->CNT = 0;

        // Отображение временного интервала на дисплей
        snprintf(message, LCD_STR_LEN, "      I = %.2f s", interval);
        LCD_PutString(message, 7);

        // Ожидание отпускания
        while ((MDR_PORTC->RXTX & (1 << 2)) == 0)
          osDelay(25);
      }
    }

    // Задержка перед началом следующей проверки
    osDelay(25);
  }
}
